## Kconfig
```kconfig
#
# Copyright 2024-2026 NXP
#
# SPDX-License-Identifier: BSD-3-Clause

menu "PSA Crypto Driver"

    ##################################################################
    #                       PSA Crypto Driver                        #
    ##################################################################

    rsource "./Kconfig.psa_crypto_driver"

    ##################################################################
    #                           MbedTLS                              #
    ##################################################################

    rsource "./Kconfig.mbedtls"

    ##################################################################
    #                        TF-PSA-Crypto                           #
    ##################################################################

    rsource "./Kconfig.tf_psa_crypto"

endmenu
```

## Kconfig.mbedtls
```kconfig
#
# Copyright 2024-2026 NXP
#
# SPDX-License-Identifier: BSD-3-Clause

    config MCUX_COMPONENT_middleware.mbedtls
        bool "MbedTLS middleware"

    config MCUX_COMPONENT_middleware.mbedtls.default_config
        default true if MCUX_COMPONENT_middleware.mbedtls
        bool "Default MCUX MbedTLS configuration header"
```
